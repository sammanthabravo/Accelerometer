## build/Kconfig/arch/Kconfig
```kconfig
# Load Zephyr Arch Kconfig descriptions.
osource "/home/sba/rtes/zephyr/arch/rx/Kconfig"
osource "/home/sba/rtes/zephyr/arch/x86/Kconfig"
osource "/home/sba/rtes/zephyr/arch/xtensa/Kconfig"
osource "/home/sba/rtes/zephyr/arch/sparc/Kconfig"
osource "/home/sba/rtes/zephyr/arch/riscv/Kconfig"
osource "/home/sba/rtes/zephyr/arch/posix/Kconfig"
osource "/home/sba/rtes/zephyr/arch/mips/Kconfig"
osource "/home/sba/rtes/zephyr/arch/arm64/Kconfig"
osource "/home/sba/rtes/zephyr/arch/arm/Kconfig"
osource "/home/sba/rtes/zephyr/arch/arc/Kconfig"
```

## build/Kconfig/boards/Kconfig.bbc_microbit_v2
```kconfig
# Load board Kconfig descriptions.
osource "/home/sba/rtes/zephyr/boards/bbc/microbit_v2/Kconfig.bbc_microbit_v2"
```

## build/Kconfig/boards/Kconfig.defconfig
```kconfig
# Load Zephyr board defconfig descriptions.
osource "/home/sba/rtes/zephyr/boards/bbc/microbit_v2/Kconfig.defconfig"
```

## build/Kconfig/boards/Kconfig.sysbuild
```kconfig
# Load Sysbuild board Kconfig descriptions.
osource "/home/sba/rtes/zephyr/boards/bbc/microbit_v2/Kconfig.sysbuild"
```
